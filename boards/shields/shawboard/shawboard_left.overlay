/*
 * Copyright (c) 2020 The ZMK Contributors
 *
 * SPDX-License-Identifier: MIT
 */

#include "shawboard.dtsi"
#include "shawboard-layouts.dtsi"

&physical_layout0 {

    transform = <&default_transform>;
};
